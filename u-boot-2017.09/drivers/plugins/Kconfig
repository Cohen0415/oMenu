## u-boot-2017.09/drivers/plugins/Kconfig
```kconfig
menuconfig OMENU
    bool "oMenu"
    default n
    help
      Enable the Device Tree Overlay (DTBO) plugin menu system in U-Boot.
      When enabled, allows selection and configuration of DTBO plugins
      such as LCD, I2C, SPI via directory-based structure.

      启用 oMenu：U-Boot 中的设备树覆盖（DTBO）插件系统。
      启用后可通过菜单选择和配置插件设备树（如 LCD、I2C、SPI 等）。

if OMENU

config OMENU_MMC_DEV_NUM
    string "MMC Device"
    default "0"
    help
      MMC device number where DTBO overlays are stored.
      通常为启动 TF 卡或 eMMC 的设备号，如 mmc 0 或 mmc 1。

config OMENU_MMC_PARTITION
    string "MMC Partition"
    default "0"
    help
      Partition number in MMC device where /omenu resides.
      对应分区编号，如 1 表示 mmc 0:1。

endif # OMENU
```

## u-boot/drivers/omenu/Kconfig
```kconfig
menuconfig OMENU
    bool "oMenu"
    default n
    select OMENU_LOG_ENABLE
    help
      Enable the oMenu Device Tree Overlay (DTBO) plugin system in U-Boot.
      When enabled, allows selection and configuration of DTBO plugins
      such as LCD, I2C, SPI via a directory-based structure.

      启用 oMenu：U-Boot 中的设备树覆盖（DTBO）插件系统。
      启用后可通过菜单选择和配置插件设备树（如 LCD、I2C、SPI 等）。

if OMENU

choice
    prompt "Storage Type"
    default OMENU_STORAGE_MMC
    help
      Select where DTBO plugins are stored.

config OMENU_STORAGE_MMC
    bool "MMC (eMMC / SD)"
    help
      Use MMC device (eMMC, SD card) as the storage for DTBO plugins.

endchoice

config OMENU_STORAGE_DEV_NUM
    string "Storage Device Number"
    default "0"
    help
      Device number of selected storage type, such as mmc 0 or usb 0.
      存储设备的编号，例如 mmc 0 表示 eMMC 或 TF 卡，usb 0 表示第一个 U 盘。

config OMENU_STORAGE_PART_NUM
    string "Storage Partition Number"
    default "0"
    help
      Partition number of the selected storage device where /omenu resides.
      插件目录所在的分区号，例如 1 表示存储设备的第一个分区（如 mmc 0:1）。

config OMENU_DIRECTORY_NAME
    string "Directory Name"
    default "omenu"
    help
      Name of the directory containing DTBO plugins for oMenu.
      插件设备树所在目录名。

config OMENU_LOG_ENABLE
    bool
    default y

config OMENU_LOG_LEVEL
    int "Default log level (0:INFO, 1:WARN, 2:ERROR, 3:DEBUG)"
    depends on OMENU_LOG_ENABLE
    range 0 3
    default 0
    help
      Select the minimum log level oMenu will output.
      仅打印级别小于等于该值的日志（0=仅 INFO，3=全部）。

endif # OMENU
```

## u-boot/drivers/plugins/Kconfig
```kconfig
menuconfig OMENU
    bool "oMenu"
    default n
    select OMENU_LOG_ENABLE
    help
      Enable the oMenu Device Tree Overlay (DTBO) plugin system in U-Boot.
      When enabled, allows selection and configuration of DTBO plugins
      such as LCD, I2C, SPI via a directory-based structure.

      启用 oMenu：U-Boot 中的设备树覆盖（DTBO）插件系统。
      启用后可通过菜单选择和配置插件设备树（如 LCD、I2C、SPI 等）。

if OMENU

config OMENU_MMC_DEV_NUM
    string "MMC Device"
    default "0"
    help
      MMC device number where DTBO overlays are stored.
      通常为启动 TF 卡或 eMMC 的设备号，如 mmc 0 或 mmc 1。

config OMENU_MMC_PARTITION
    string "MMC Partition"
    default "0"
    help
      Partition number in the MMC device where /omenu resides.
      对应分区编号，如 1 表示 mmc 0:1。

config OMENU_DIRECTORY_NAME
    string "Directory Name"
    default "omenu"
    help
      Name of the directory containing DTBO plugins for oMenu.
      插件设备树所在目录名。

config OMENU_LOG_ENABLE
    bool
    default y

if OMENU_LOG_ENABLE

config OMENU_LOG_LEVEL
    int "Default log level (0:INFO, 1:WARN, 2:ERROR, 3:DEBUG)"
    depends on OMENU_LOG_ENABLE
    range 0 3
    default 0
    help
      Select the minimum log level oMenu will output.
      仅打印级别小于等于该值的日志（0=仅 INFO，3=全部）。

endif # OMENU_LOG_ENABLE

endif # OMENU
```
